## package/Config.in
```kconfig
menu "Networking applications"  
	source "$BR2_EXTERNAL_COREOS/package/openresty/Config.in"
endmenu
```

## package/oauth2_proxy/Config.in
```kconfig
config BR2_PACKAGE_OAUTH2_PROXY
	bool "oauth2_proxy"
	depends on host-go
	help
	  OAUTH2_PROXY with patches to support CoreOS Dex

	  https://github.com/coreos/oauth2_proxy
```

## package/python-fedora/Config.in
```kconfig
config BR2_PACKAGE_PYTHON_FEDORA
	bool "python-fedora"
	select BR2_PACKAGE_PYTHON_SSL
	select BR2_PACKAGE_PYTHON_MUNCH # runtime
	select BR2_PACKAGE_PYTHON_KITCHEN # runtime
	select BR2_PACKAGE_PYTHON_REQUESTS # runtime
	select BR2_PACKAGE_PYTHON_BEAUTIFULSOUP4 # runtime
	select BR2_PACKAGE_PYTHON_URLLIB3 # runtime
	select BR2_PACKAGE_PYTHON_SIX # runtime
	select BR2_PACKAGE_PYTHON_LOCKFILE # runtime
	help
	  Python modules for interacting with Fedora Services.

	  https://fedorahosted.org/python-fedora
```

## package/python-fs/Config.in
```kconfig
config BR2_PACKAGE_PYTHON_FS
	bool "python-fs"
	select BR2_PACKAGE_PYTHON_SETUPTOOLS # runtime
	select BR2_PACKAGE_PYTHON_SIX # runtime
	help
	  Filesystem abstraction layer.

	  http://pypi.python.org/pypi/fs/
```

## package/python-kitchen/Config.in
```kconfig
config BR2_PACKAGE_PYTHON_KITCHEN
	bool "python-kitchen"
	help
	  Kitchen contains a cornucopia of useful code.

	  https://fedorahosted.org/kitchen
```

## package/python-lockfile/Config.in
```kconfig
config BR2_PACKAGE_PYTHON_LOCKFILE
	bool "python-lockfile"
	select BR2_PACKAGE_PYTHON_PBR
	depends on BR2_PACKAGE_PYTHON_PBR
	help
	Platform-independent file locking module (deprecated).

	  https://pypi.python.org/pypi/lockfile
```

## package/python-munch/Config.in
```kconfig
config BR2_PACKAGE_PYTHON_MUNCH
	bool "python-munch"
	help
	  A dot-accessible dictionary (a la JavaScript objects).

	  http://github.com/Infinidat/munch
```

## package/python-nss/Config.in
```kconfig
config BR2_PACKAGE_PYTHON_NSS
	bool "python-nss"
	select BR2_PACKAGE_PYTHON_CFFI # runtime
	help
	  Python bindings for Network Security Services (NSS) and Netscape
	  Portable Runtime (NSPR).

	  http://www.mozilla.org/projects/security/pki/python-nss
```

## package/python-pbr/Config.in
```kconfig
config BR2_PACKAGE_PYTHON_PBR
	bool "python-pbr"
	help
	  Python Build Reasonableness.

	  https://launchpad.net/pbr
```

## package/python-pycurl/Config.in
```kconfig
	config BR2_PACKAGE_PYTHON_PYCURL
	bool "python-pycurl"
	select BR2_PACKAGE_LIBCURL # runtime
	help
	  PycURL -- A Python Interface To The cURL library
		https://github.com/pycurl/pycurl
```

## package/python-pygpgme/Config.in
```kconfig
config BR2_PACKAGE_PYTHON_PYGPGME
	bool "python-pygpgme"
	help
	  A Python module for working with OpenPGP messages.

	  https://launchpad.net/pygpgme
```

## package/python-pysqlite/Config.in
```kconfig
config BR2_PACKAGE_PYTHON_PYSQLITE
	bool "python-pysqlite"
	help
		DB-API 2.0 interface for SQLite 3.x
		
		http://github.com/ghaering/pysqlite
```

## package/python-urlgrabber/Config.in
```kconfig
config BR2_PACKAGE_PYTHON_URLGRABBER
	bool "python-urlgrabber"
	select BR2_PACKAGE_PYTHON_PYCURL
	help
	  A high-level cross-protocol url-grabber.

		http://linux.duke.edu/projects/urlgrabber/
```

## package/sigul/Config.in
```kconfig
config BR2_PACKAGE_SIGUL
	bool "sigul"
	select BR2_PACKAGE_PYTHON_FEDORA # runtime
	select BR2_PACKAGE_PYTHON_MUNCH # runtime
	select BR2_PACKAGE_PYTHON_KITCHEN # runtime
	select BR2_PACKAGE_PYTHON_REQUESTS # runtime
	select BR2_PACKAGE_PYTHON_BEAUTIFULSOUP4 # runtime
	select BR2_PACKAGE_PYTHON_NSS # runtime
	select BR2_PACKAGE_PYTHON_URLLIB3 # runtime
	select BR2_PACKAGE_PYTHON_SIX # runtime
	select BR2_PACKAGE_PYTHON_PYSQLITE # runtime
	select BR2_PACKAGE_PYTHON_LOCKFILE # runtime
	select BR2_PACKAGE_PYTHON_SQLALCHEMY # runtime
	select BR2_PACKAGE_PYTHON_URLGRABBER # runtime
	select BR2_PACKAGE_PYTHON_PYGPGME # runtime
	help
	  sigul: An automated gpg signing system

	  https://fedorahosted.org/sigul
```
